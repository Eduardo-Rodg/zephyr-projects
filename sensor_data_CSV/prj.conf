## CMakeLists.txt
```
cmake_minimum_required(VERSION 3.20.0)

find_package(Zephyr REQUIRED HINTS $ENV{ZEPHYR_BASE})
project(sensor_data_csv)

target_sources(app PRIVATE src/main.c)

target_include_directories(app PRIVATE ${CMAKE_CURRENT_BINARY_DIR})

file(READ
    ${CMAKE_CURRENT_SOURCE_DIR}/data/analogtest_data_Abel.csv
    CSV_CONTENT
)

string(REPLACE "\\" "\\\\" CSV_CONTENT "${CSV_CONTENT}")
string(REPLACE "\"" "\\\"" CSV_CONTENT "${CSV_CONTENT}")
string(REPLACE "\n" "\\n\"\n\"" CSV_CONTENT "${CSV_CONTENT}")

configure_file(
    ${CMAKE_CURRENT_SOURCE_DIR}/csv_data.h.in
    ${CMAKE_CURRENT_BINARY_DIR}/csv_data.h
    @ONLY
)
```

## prj.conf
```kconfig
CONFIG_SERIAL=y
CONFIG_CONSOLE=y
CONFIG_UART_CONSOLE=y

CONFIG_LOG=y
CONFIG_LOG_DEFAULT_LEVEL=3
CONFIG_LOG_MODE_IMMEDIATE=y

CONFIG_PRINTK=y
```

## src/main.c
```c
#include <zephyr/kernel.h>
#include <zephyr/logging/log.h>
#include "csv_data.h"

LOG_MODULE_REGISTER(csv_flash, LOG_LEVEL_INF);

int main(void)
{
    LOG_INF("CSV cargado desde flash:");

    printk("\n%s\n", csv_data);

    while (1) {
        k_sleep(K_SECONDS(1));
    }

    return 0;
}
```
